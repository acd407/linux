## Documentation/devicetree/bindings/display/bridge/hisilicon,histb-hdmi-1-4.yaml
```yaml
# SPDX-License-Identifier: (GPL-2.0-only OR BSD-2-Clause)
%YAML 1.2
---
$id: http://devicetree.org/schemas/display/bridge/hisilicon,histb-hdmi-1-4.yaml#
$schema: http://devicetree.org/meta-schemas/core.yaml#

title: HiSilicon STB HDMI 1.4 transmitter

maintainers:
  - David Yang <mmyangfl@gmail.com>

description:
  The HDMI 1.4 transmitter integrated in HiSilicon STB SoCs, a Silicon
  Image SiI9134 core plus an on-chip PHY. The two I2C banks of the
  standalone part are flattened into one register window, bank 0 at the
  base, bank 1 at offset 0x400 and the 32-bit PHY registers at offset
  0x1800, so a single 64 KiB reg entry covers all three.

  The clock gates and resets of the block are not modelled as clocks by
  the CRG driver yet, which is why the reset names below are the bit
  numbers the driver has to release by hand.

properties:
  compatible:
    const: hisilicon,histb-hdmi-1-4

  '#sound-dai-cells':
    const: 0

  reg:
    maxItems: 1

  interrupts:
    maxItems: 1

  resets:
    maxItems: 3

  reset-names:
    items:
      - const: base
      - const: bus
      - const: phy

  ddc-i2c-bus:
    $ref: /schemas/types.yaml#/definitions/phandle
    description:
      I2C master to use for the DDC bus when it is wired to a system
      controller instead of the transmitter's own reduced master. Without
      this property the hardware master DDC is used.

  ports:
    $ref: /schemas/graph.yaml#/properties/ports

    properties:
      port@0:
        $ref: /schemas/graph.yaml#/properties/port
        description:
          Pixel input from the VO channel.

    required:
      - port@0

required:
  - compatible
  - reg
  - ports

additionalProperties: false

examples:
  - |
    hdmi@8ce0000 {
        compatible = "hisilicon,histb-hdmi-1-4";
        reg = <0x8ce0000 0x10000>;
        interrupts = <88 4>;
        resets = <&crg 0x10c 9>, <&crg 0x10c 8>, <&crg 0x110 4>;
        reset-names = "base", "bus", "phy";
        #sound-dai-cells = <0>;

        ports {
            #address-cells = <1>;
            #size-cells = <0>;

            port@0 {
                reg = <0>;

                hdmi_in_vo: endpoint {
                    remote-endpoint = <&vo_out_hdmi>;
                };
            };
        };
    };
```

## Documentation/devicetree/bindings/regulator/hisilicon,histb-volt.yaml
```yaml
# SPDX-License-Identifier: (GPL-2.0-only OR BSD-2-Clause)
%YAML 1.2
---
$id: http://devicetree.org/schemas/regulator/hisilicon,histb-volt.yaml#
$schema: http://devicetree.org/meta-schemas/core.yaml#

title: HiSilicon STB PWM controlled voltage regulator

maintainers:
  - David Yang <mmyangfl@gmail.com>

description: |
  HiSilicon STB SoCs provide PWM outputs in the PMOC block which drive an
  external converter. The output voltage is set by the duty cycle of the PWM
  signal: the register holds duty cycle + 1 in bits 31:16 and period + 1 in
  bits 15:0, both counted in oscillator periods, and a larger duty cycle
  results in a lower output voltage.

properties:
  compatible:
    const: hisilicon,histb-volt

  reg:
    maxItems: 1

required:
  - compatible
  - reg
  - regulator-min-microvolt
  - regulator-max-microvolt

allOf:
  - $ref: regulator.yaml#

unevaluatedProperties: false

examples:
  - |
    vddcpu: regulator@8a23018 {
        compatible = "hisilicon,histb-volt";
        reg = <0x8a23018 0x4>;
        regulator-name = "vdd-cpu";
        regulator-min-microvolt = <700000>;
        regulator-max-microvolt = <1250000>;
        regulator-always-on;
    };
```
